## accel/Kconfig
```kconfig
config WHPX
    bool

config HVF
    bool

config TCG
    bool

config KVM
    bool
```

## hw/Kconfig
```kconfig
# devices Kconfig
source audio/Kconfig
source block/Kconfig
source char/Kconfig
source core/Kconfig
source display/Kconfig
source dma/Kconfig
source gpio/Kconfig
source i2c/Kconfig
source input/Kconfig
source intc/Kconfig
source misc/Kconfig
source net/Kconfig
source nvme/Kconfig
source nvram/Kconfig
source pci-bridge/Kconfig
source pci-host/Kconfig
source pci/Kconfig
source rtc/Kconfig
source sd/Kconfig
source sensor/Kconfig
source spmi/Kconfig
source ssi/Kconfig
source timer/Kconfig
source usb/Kconfig
source watchdog/Kconfig

# arch Kconfig
source arm/Kconfig
source cpu/Kconfig

# Symbols used by multiple targets
config TEST_DEVICES
    bool
```

## hw/arm/Kconfig
```kconfig
config APPLE_DART
    bool
    depends on APPLE_SOC

config APPLE_SART
    bool
    depends on APPLE_SOC

config APPLE_SOC
    bool
    default y
    depends on TCG && ARM && AARCH64
    select AT24C
    select I2C
    select PCI
    select PCI_BRIDGE
    select PCI_DEVICES
    select PCI_EXPRESS
    select PCIE_PORT
    select PCIE_PCI_BRIDGE
    select EXYNOS4210_UART
    select OR_IRQ
    select UNIMP
    select APPLE_ANS
    select APPLE_NVME_MMU
    select APPLE_I2C
    select APPLE_OTG
    select APPLE_TYPEC
    select APPLE_NVRAM
    select APPLE_SIO
    select APPLE_SPMI
    select APPLE_SPMI_PMU
    select APPLE_SPMI_BASEBAND
    select APPLE_DART
    select APPLE_SART
    select APPLE_SPI
    select APPLE_UART
    select FRAMEBUFFER # adp-v2/adp-v4
    select CPU_CLUSTER # A13
```

## hw/block/Kconfig
```kconfig
config APPLE_ANS
    bool
    select NVME_PCI
    depends on APPLE_SOC

config APPLE_NVME_MMU
    bool
    select NVME_PCI
    depends on APPLE_SOC
```

## hw/display/Kconfig
```kconfig
config DDC
    bool
    depends on I2C
    select EDID

config EDID
    bool

config FRAMEBUFFER
    bool

config DPCD
    bool
    select AUX
```

## hw/intc/Kconfig
```kconfig
config ARM_GIC
    bool
    select ARM_GICV3 if TCG
    select ARM_GIC_KVM if KVM

config ARM_GICV3
    bool
    depends on ARM_GIC

config ARM_GIC_KVM
    bool
    depends on ARM_GIC && KVM
```

## hw/misc/Kconfig
```kconfig
config AUX
    bool
    select I2C

config UNIMP
    bool

config LED
    bool

config APPLE_SPMI_PMU
    bool
    depends on APPLE_SOC
    depends on SPMI

config APPLE_SPMI_BASEBAND
    bool
    depends on APPLE_SOC
    depends on SPMI
```

## hw/nvram/Kconfig
```kconfig
config AT24C
    bool
    depends on I2C

config CHRP_NVRAM
    bool

config APPLE_NVRAM
    bool
    select CHRP_NVRAM
    depends on APPLE_SOC
```

## hw/pci-bridge/Kconfig
```kconfig
config PCI_BRIDGE
    bool
    default y if PCI_DEVICES
    depends on PCI

config PCIE_PORT
    bool
    default y if PCI_DEVICES
    depends on PCI_EXPRESS

config PCIE_PCI_BRIDGE
    bool
    default y if PCIE_PORT
    depends on PCIE_PORT
```

## hw/pci-host/Kconfig
```kconfig
config PAM
    bool

config PCI_EXPRESS_GENERIC_BRIDGE
    bool
    select PCI_EXPRESS
```

## target/arm/Kconfig
```kconfig
config ARM
    bool

config AARCH64
    bool
    select ARM
    # kvm_arch_fixup_msi_route() needs to access PCIDevice
    select PCI if KVM
```
